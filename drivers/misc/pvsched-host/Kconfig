## drivers/misc/pvsched-host/Kconfig
```kconfig
# SPDX-License-Identifier: GPL-2.0-only
config PVSCHED_HOST
	tristate "Paravirt Scheduling host module"
	help
	  This driver provides paravirt scheduling policy for guest cabaple of
	  paravirt scheduling.

	  To compile this driver as a module, choose M here. The module
	  will be called pvsched-host.
```

## drivers/misc/pvsched/Kconfig
```kconfig
# SPDX-License-Identifier: GPL-2.0+
#
# Pvsched Kconfig
#
# Copyright (C) 2024 Google.
#

config PVSCHED_PCI
	tristate "pvsched PCI device support"
	depends on PCI
	help
	  pvsched is a paravirtualized device provided by crosvm; it lets
	  a virtual machine (guest) share scheduling information with the
	  host so as to enable the host and guest to make better scheduling
	  decisions.
```
